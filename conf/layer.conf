## conf/layer.conf
```bitbake
# We have a conf and classes directory, add to BBPATH
BBPATH .= ":${LAYERDIR}"

# We have a packages directory, add to BBFILES
BBFILES += " \
    ${LAYERDIR}/recipes-*/*/*.bb \
    ${LAYERDIR}/recipes-*/*/*.bbappend \
    "

BBFILE_COLLECTIONS += "vitis-ai"
BBFILE_PRIORITY_vitis-ai = "5"

LAYERSUMMARY_vitis-ai = "h5pp plus Vitis AI/ML packagegroups"
LAYERDESCRIPTION_vitis-ai = "Layer providing the upstream h5pp \
HDF5 C++ wrapper and the packagegroup-vitis-aiml target and \
nativesdk-packagegroup-vitis-aiml SDK packagegroups (built mostly \
from upstream Python projects)."
BBFILE_PATTERN_vitis-ai = "^${LAYERDIR}/"
BBFILE_PATTERN_IGNORE_EMPTY_vitis-ai = "1"

LAYERDEPENDS_vitis-ai  = "core xilinx"

LAYERSERIES_COMPAT_vitis-ai = "scarthgap"

LAYERRECOMMENDS_vitis-ai = "openembedded-layer meta-python"
```
